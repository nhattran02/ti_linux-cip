## Documentation/devicetree/bindings/arm/tisoc/ti,tisoc.yaml
```yaml
# SPDX-License-Identifier: GPL-2.0
%YAML 1.2
---
$id: http://devicetree.org/schemas/arm/ti/ti,tisoc.yaml#
$schema: http://devicetree.org/meta-schemas/core.yaml#

title: TI-SoCs (tisoc) based platforms

maintainers:
  - Nhat Tran <nhat.tranminhk2@gmail.com>

description:
  Boards based on the TI-SoCs family, a Cortex-A8 SoC.

properties:
  $nodename:
    const: '/'
  compatible:
    items:
      - enum:
          - ti,tisoc-bbb    # TI-SoCs based BeagleBone Black board
      - const: ti,tisoc

additionalProperties: true

...
```

## arch/arm/mach-tisoc/Kconfig
```kconfig
# SPDX-License-Identifier: GPL-2.0-only
config ARCH_TISOC
	bool "TI-SoCs (tisoc) Cortex-A8 support"
	depends on ARCH_MULTI_V7
	help
	  Support for the TI-SoCs family based on Cortex-A8.
      
```
